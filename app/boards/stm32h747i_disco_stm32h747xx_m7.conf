## app/boards/stm32h747i_disco_stm32h747xx_m7.conf
```kconfig
CONFIG_COMMON_LIBC_MALLOC_ARENA_SIZE=30971520
CONFIG_LOG=y
CONFIG_CONSOLE=y
CONFIG_DISPLAY=y
CONFIG_LOG_MODE_DEFERRED=y
CONFIG_LOG_INFO_COLOR_GREEN=y
CONFIG_COMMON_LIBC_MALLOC=y
CONFIG_POSIX_THREADS=y
CONFIG_POSIX_FILE_SYSTEM=y
CONFIG_POSIX_API=y
CONFIG_POSIX_DEVICE_IO=y
CONFIG_POSIX_FD_MGMT=y
CONFIG_ZVFS_OPEN_MAX=16
CONFIG_SDCARD_IMAGE=y
CONFIG_FILE_SYSTEM_EXT2=y
CONFIG_DISK_ACCESS=y
CONFIG_MEMC=y

CONFIG_REBOOT=y

CONFIG_CPP_RTTI=y
CONFIG_STD_CPP23=y
CONFIG_REQUIRES_FULL_LIBCPP=y

CONFIG_INPUT=y
CONFIG_INPUT_QUEUE_MAX_MSGS=128
CONFIG_INPUT_MODE_THREAD=y

CONFIG_USB_HOST_STACK=y
CONFIG_USBH_STACK_SIZE=2048

CONFIG_USBH_HID_BOOT_CLASS=y
CONFIG_USBH_HID_BOOT_INSTANCES_COUNT=4

CONFIG_STM32_LTDC_RGB888=y
CONFIG_DISPLAY_LOG_LEVEL_WRN=y
CONFIG_NT35510=n
CONFIG_DISPLAY_NT35510_INIT_PRIORITY=87

CONFIG_I2C=y
CONFIG_I2C_STM32=y

CONFIG_GPIO=y
CONFIG_GPIO_STM32=y

CONFIG_SPI=y

CONFIG_APP_LOG_LEVEL_DBG=y

CONFIG_FPU=y
```

## west.yml
```yaml
manifest:
  projects:
    - name: zephyr
      url: https://github.com/antmicro/zephyr.git
      revision: hdmi-usb-combined
      import:
        name-allowlist:
          - cmsis_6
          - hal_stm32
    - name: grvl
      path: modules/grvl
      url: https://github.com/antmicro/grvl.git
      revision: main
```
